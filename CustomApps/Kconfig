## CustomApps/SensorRead/Kconfig
```kconfig
#
# For a description of the syntax of this configuration file,
# see the file kconfig-language.txt in the NuttX tools repository.

config CUSTOM_APPS_SENSOR_READ
    tristate "Sensor read Example"
    default n
    ---help---
        Enable the sensor read example

if CUSTOM_APPS_SENSOR_READ

config CUSTOM_APPS_SENSOR_READ_PROGNAME
    string "Sensor Read"
    default "sensor_read"
    ---help---
        This is the name of the program that will be used when the NSH ELF
        program is installed.

config CUSTOM_APPS_SENSOR_READ_PRIORITY
    int "Sensor Read example task priority"
    default 100

config CUSTOM_APPS_SENSOR_READ_STACKSIZE
    int "Task stack size"
    default DEFAULT_TASK_STACKSIZE

endif
```

## CustomApps/TaskQueue/Kconfig
```kconfig
#
# For a description of the syntax of this configuration file,
# see the file kconfig-language.txt in the NuttX tools repository.

config CUSTOM_APPS_TASK_QUEUE
    tristate "Task Queue Example"
    default n
    ---help---
        Enable the Task Queue Example

if CUSTOM_APPS_TASK_QUEUE

config CUSTOM_APPS_TASK_QUEUE_PROGNAME
    string "Task Queue"
    default "task_queue"
    ---help---
        This is the name of the program that will be used when the NSH ELF
        program is installed.

config CUSTOM_APPS_TASK_QUEUE_PRIORITY
    int "Task Queue example task priority"
    default 100

config CUSTOM_APPS_TASK_QUEUE_STACKSIZE
    int "Task stack size"
    default DEFAULT_TASK_STACKSIZE

endif
```

## CustomApps/TaskZero/Kconfig
```kconfig
#
# For a description of the syntax of this configuration file,
# see the file kconfig-language.txt in the NuttX tools repository.

config CUSTOM_APPS_TASK_ZERO
    tristate "Task Zero Example"
    default n
    ---help---
        Enable the Task Zero Example

if CUSTOM_APPS_TASK_ZERO

config CUSTOM_APPS_TASK_ZERO_PROGNAME
    string "Task Zero"
    default "task_zero"
    ---help---
        This is the name of the program that will be used when the NSH ELF
        program is installed.

config CUSTOM_APPS_TASK_ZERO_PRIORITY
    int "Task Zero example task priority"
    default 100

config CUSTOM_APPS_TASK_ZERO_STACKSIZE
    int "Task stack size"
    default DEFAULT_TASK_STACKSIZE

endif
```

## examples/mpu6050/Kconfig
```kconfig
#
# For a description of the syntax of this configuration file,
# see the file kconfig-language.txt in the NuttX tools repository.
#

config EXAMPLES_MPU6050
	tristate "MPU6050 example"
	default n
	---help---
		Enable the MPU6050 example

if EXAMPLES_MPU6050

config EXAMPLES_MPU6050_PROGNAME
	string "Program name"
	default "mpu6050"
	---help---
		This is the name of the program that will be used when the NSH ELF
		program is installed.

config MPU6050_DEVICE_PATH
	string "MPU6050 device name"
	default "/dev/imu0"
	---help---
		This is the name of the timer device that will be tested.

config EXAMPLES_MPU6050_PRIORITY
	int "MPU6050 task priority"
	default 100

config EXAMPLES_MPU6050_STACKSIZE
	int "MPU6050 stack size"
	default DEFAULT_TASK_STACKSIZE

endif
```
